## configs/itop4412_defconfig
```kconfig
##开发板型号配置
CONFIG_ARM=y
CONFIG_ARCH_EXYNOS=y
CONFIG_SYS_TEXT_BASE=0x43E00000
CONFIG_ARCH_EXYNOS4=y
CONFIG_TARGET_ITOP4412=y
CONFIG_IDENT_STRING=" for ITOP4412"
##控制台配置
CONFIG_SYS_PROMPT="u-boot # "
##SPL配置
CONFIG_SPL=y
CONFIG_SPL_FRAMEWORK=n
##设备树配置
CONFIG_OF_CONTROL=y
CONFIG_DEFAULT_DEVICE_TREE="exynos4412-itop4412"
##常规启动项
CONFIG_SD_BOOT=y
CONFIG_DISTRO_DEFAULTS=y
CONFIG_SYS_CONSOLE_IS_IN_ENV=y
CONFIG_SYS_CONSOLE_INFO_QUIET=y
# CONFIG_USE_BOOTCOMMAND is not set
##支持命令配置
# CONFIG_CMD_XIMG is not set
#CONFIG_CMD_THOR_DOWNLOAD=y
#CONFIG_CMD_DFU=y
CONFIG_CMD_GPT=y
CONFIG_CMD_MMC=y
#CONFIG_CMD_USB_MASS_STORAGE=y
#CONFIG_CMD_CACHE=y
# CONFIG_CMD_MISC is not set
CONFIG_CMD_EXT4_WRITE=y
CONFIG_CMD_USB=y
CONFIG_CMD_PING=y
# CONFIG_CMD_NFS is not set
CONFIG_CMD_FS_GENERIC=y
CONFIG_CMD_FDISK=y
##支持驱动配置
CONFIG_DM=y
CONFIG_DM_MMC=y
#CONFIG_DFU_MMC=y
CONFIG_MMC=y
CONFIG_MMC_DW=y
CONFIG_MMC_SDHCI=y
CONFIG_MMC_SDHCI_SDMA=y
CONFIG_MMC_SDHCI_S5P=y
#USB
CONFIG_USB=y
CONFIG_DM_USB=y
CONFIG_USB_HOST=y
CONFIG_USB_EHCI_HCD=y
CONFIG_USB_STORAGE=y
CONFIG_USB_GADGET=y
CONFIG_USB_GADGET_MANUFACTURER="samsung"
CONFIG_USB_GADGET_VENDOR_NUM=0x04e8
CONFIG_USB_GADGET_PRODUCT_NUM=0x685d
CONFIG_USB_GADGET_DWC2_OTG=y
CONFIG_USB_GADGET_VBUS_DRAW=2
CONFIG_USB_GADGET_DUALSPEED=y
CONFIG_USB_GADGET_DOWNLOAD=y
CONFIG_USB_HOST_ETHER=y
CONFIG_USB_ETHER_DM9621=y
## Fastboot support
CONFIG_FASTBOOT=y
CONFIG_USB_FUNCTION_FASTBOOT=y
# CONFIG_UDP_FUNCTION_FASTBOOT is not set
CONFIG_FASTBOOT_BUF_ADDR=0x70000000
CONFIG_FASTBOOT_BUF_SIZE=0xa00000
CONFIG_FASTBOOT_USB_DEV=0
CONFIG_FASTBOOT_FLASH=y
CONFIG_FASTBOOT_FLASH_MMC=y
CONFIG_FASTBOOT_FLASH_MMC_DEV=0
CONFIG_FASTBOOT_GPT_NAME=""
CONFIG_FASTBOOT_MBR_NAME=""
# CONFIG_FIRMWARE is not set
#PARTITION Support
CONFIG_PARTITION_UUIDS=y
CONFIG_HUSH_PARSER=y
CONFIG_ISO_PARTITION=y
CONFIG_EFI_PARTITION=y
```
